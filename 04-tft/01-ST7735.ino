#include <SPI.h>
#include <Adafruit_GFX.h>
#include <Adafruit_ST7735.h>
#include <Fonts/Org_01.h>

// === 1.8 Inch TFT 128×160 ===
/* === SPI ===
 * TFT        ESP32
 * LED    --> 3V3
 * SCK    --> GPIO 18
 * SDA    --> GPIO 23
 * A0(DC) --> GPIO 2
 * RST    --> GPIO 4
 * CS     --> GPIO 15
 * GND    --> GND
 * VCC    --> 3V3
 */

#define LANDSCAPE false
#define FLIP true
#define TFT_DC 2   // === data/command pin ===
#define TFT_RST 4  // === reset pin ===
#define TFT_CS 15  // === chip select pin ===
#define TFT_MS 250 // === delay before initializing the display ===
Adafruit_ST7735 tft = Adafruit_ST7735(TFT_CS, TFT_DC, TFT_RST);

void background(uint16_t color)
{
	tft.fillScreen(color);
}

uint16_t rgb(uint8_t r, uint8_t g, uint8_t b)
{
	return tft.color565(r, g, b);
}

void clearDisplay()
{
	tft.fillScreen(ST77XX_BLACK);
}

void setupTFT()
{
	delay(TFT_MS);
	tft.initR(INITR_BLACKTAB);

	int rotate = 0;
	if (LANDSCAPE && FLIP)
		rotate = 3;
	else if (FLIP)
		rotate = 2;
	else if (LANDSCAPE)
		rotate = 1;
	tft.setRotation(rotate);

	clearDisplay();
	Serial.println(F("✅ TFT OK"));
}

// === === === === === === === === === === ===

void setupSerial()
{
	Serial.begin(9600);
	for (int i = 0; i < 10; i++)
	{
		delay(100);
		Serial.println(F("."));
	}
	Serial.println(F("✅ Serial OK"));
}

void demo()
{
	static const unsigned char PROGMEM ICON_SMILE[] = {0x00, 0x00, 0x00, 0x00, 0x00, 0x00, 0x00, 0x00, 0x00, 0x00, 0x00, 0x00, 0x00,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 0x00, 0x00};

	background(rgb(6, 10, 20));
	tft.setTextWrap(false);
	tft.setTextColor(rgb(0, 0, 255));
	tft.setTextSize(2);
	tft.setFont(&Org_01);
	tft.setCursor(21, 40);
	tft.print("YOU ARE");

	tft.setTextColor(rgb(255, 0, 255));
	tft.setTextSize(3);
	tft.setCursor(16, 60);
	tft.print("GREAT!");

	tft.drawBitmap(35, 94, ICON_SMILE, 58, 28, rgb(0, 255, 0));
}

void setup()
{
	setupSerial();
	setupTFT();
	demo();
}

void loop()
{
}