#include <Adafruit_GFX.h>
#include <MCUFRIEND_kbv.h>
#include <Fonts/Org_01.h>

// === 3.5 Inch TFT 320×480 ===
/* === 8-bit LCD ===
 * TFT Shield     Arduino Nano
 * LCD_RST    --> A4
 * LCD_CS     --> A3
 * LCD_RS     --> A2
 * LCD_WR     --> A1
 * LCD_RD     --> A0
 * LCD_D0     --> GPIO 8
 * LCD_D1     --> GPIO 9
 * LCD_D2     --> GPIO 2
 * LCD_D3     --> GPIO 3
 * LCD_D4     --> GPIO 4
 * LCD_D5     --> GPIO 5
 * LCD_D6     --> GPIO 6
 * LCD_D7     --> GPIO 7
 * GND        --> GND
 * 5V         --> 5V
 */

#define LANDSCAPE false
#define FLIP false
#define TFT_MS 250
MCUFRIEND_kbv tft;

void background(uint16_t color)
{
	tft.fillScreen(color);
}

uint16_t rgb(uint8_t r, uint8_t g, uint8_t b)
{
	return tft.color565(r, g, b);
}

void clearDisplay()
{
	tft.fillScreen(0x0000);
}

void setupTFT()
{
	uint16_t ID = tft.readID();
	if (ID == 0xD3D3)
		ID = 0x9481;
	delay(TFT_MS);
	tft.begin(ID);

	int rotate = 0;
	if (LANDSCAPE && FLIP)
		rotate = 3;
	else if (FLIP)
		rotate = 2;
	else if (LANDSCAPE)
		rotate = 1;
	tft.setRotation(rotate);

	clearDisplay();
	Serial.println(F("✅ TFT OK"));
}

// === === === === === === === === === === ===

void setupSerial()
{
	Serial.begin(9600);
	for (int i = 0; i < 10; i++)
	{
		delay(100);
		Serial.println(F("."));
	}
	Serial.println(F("✅ Serial OK"));
}

void demo()
{
	static const unsigned char PROGMEM ICON_SMILE[] = {0x00, 0x00, 0x00, 0x00, 0x00, 0x00, 0x00, 0x00, 0x00, 0x00, 0x00, 0x00, 0x00,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 0x00, 0x00};

	background(rgb(6, 10, 20));
	tft.setTextWrap(false);
	tft.setTextColor(rgb(0, 0, 255));
	tft.setTextSize(6);
	tft.setFont(&Org_01);
	tft.setCursor(34, 122);
	tft.print("YOU ARE");

	tft.setTextColor(rgb(255, 0, 255));
	tft.setTextSize(8);
	tft.setCursor(32, 188);
	tft.print("GREAT!");

	tft.drawBitmap(15, 257, ICON_SMILE, 290, 140, rgb(0, 255, 0));
}

void setup()
{
	setupSerial();
	setupTFT();
	demo();
}

void loop()
{
}